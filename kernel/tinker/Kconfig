## kernel/tinker/Kconfig
```kconfig
# SPDX-License-Identifier: GPL-2.0
#
# KorrinOS core kernel features
#
# Hardware-throughput-code desktop OS features implemented as real
# kernel C code, inside the Linux kernel. See AGENTS.md in the repo root
# for the project origin and mission.

menuconfig TINKER_FEATURES
	bool "KorrinOS core kernel features"
	help
	  KorrinOS hardware-throughput-code features: thermal-aware
	  scheduling hints, game-mode boost knob, energy/DVFS governor
	  hinting, and battery/backlight lifespan management.

	  These are experimental kernel enhancements, enabled by default
	  when the menu is activated. They are safe to disable entirely.

if TINKER_FEATURES

config TINKER_CORE
	bool "KorrinOS core interface (/proc/tinker)"
	default y
	help
	  Core KorrinOS procfs interface and sysctls. Provides
	  /proc/tinker/{thermal,gamemode,energy,battery,oled,status}.

config TINKER_THERMAL_SCHED
	bool "Thermal-aware scheduling hints"
	depends on TINKER_CORE && SMP
	default y
	help
	  Maintains a per-CPU thermal heat map from the kernel's thermal
	  zones and exposes/spreads load hints to avoid saturating hot
	  cores, mimicking silicon thermal-mapping schedulers without
	  touching the core scheduler data structures.

config TINKER_GAMEMODE
	bool "GameMode scheduling boost"
	depends on TINKER_CORE
	default y
	help
	  Allows boosting a process group (by TGID) to a high realtime
	  priority, mirroring the Feral GameMode background service as a
	  first-class kernel interface.

config TINKER_ENERGY_SCHED
	bool "Energy / DVFS hint governor"
	depends on TINKER_CORE
	default y
	help
	  Exposes a microsecond-scale energy hinting interface (peak and
	  idle voltage/frequency profiles) that the cpufreq governors can
	  consume, plus runtime energy accounting.

config TINKER_BATTERY_LIFE
	bool "Battery lifespan manager"
	depends on TINKER_CORE
	default y
	help
	  Tracks power_supply charge limits and exposes a safe charge
	  envelope (trickle charge + top-off) to prolong battery life.

config TINKER_OLED_WEAR
	bool "OLED burn-in wear compensation"
	depends on TINKER_CORE && BACKLIGHT_CLASS_DEVICE
	default y
	help
	  Exposes a proportional backlight dimming path used by the
	  display layer to balance sub-pixel wear on OLED panels.

config TINKER_CACHE_TIERING
	bool "Software-defined cache tiering (CAT/MPAM)"
	depends on TINKER_CORE
	default y
	help
	  Cache-partitioning ways profile (Intel CAT / ARM MPAM).

config TINKER_COIL_WHINE
	bool "Coil-whine killer (PWM frequency shifter)"
	depends on TINKER_CORE
	default y
	help
	  VRM PWM switching-frequency hint, consent-gated, with popup flag.

config TINKER_SHREDDER
	bool "Kernel data shredder (privacy wipe)"
	depends on TINKER_CORE && SWAP
	default y
	help
	  Kernel privacy helpers: swap-scrub policy, HW-id scramble intent.

config TINKER_DUST_DISLODGER
	bool "Acoustic dust dislodger (fan pulse)"
	depends on TINKER_CORE
	default y
	help
	  Resonant fan pulse program, idle-gated and consent-gated.

config TINKER_FPGA_SCALER
	bool "Dynamic FPGA precision scaler"
	depends on TINKER_CORE
	default y
	help
	  Precision-width profile for FPGA datapaths (energy-hint fallback).

config TINKER_ZERO_LATENCY
	bool "Zero-latency input path"
	depends on TINKER_CORE
	default y
	help
	  Low-latency input scheduling boost interface.

config TINKER_CXL_MEMORY
	bool "Unified memory over CXL"
	depends on TINKER_CORE
	default y
	help
	  Memory-pool registry (DRAM/VRAM/CXL/net) — opt-in only.

config TINKER_DVFS_SHAVER
	bool "DVFS shaver (micro V/F hint)"
	depends on TINKER_CORE
	default y
	help
	  Microsecond-scale voltage/frequency profile hints plus energy
	  accounting, fully software-driven.

config TINKER_HW_DNA
	bool "Hardware DNA (fingerprinting)"
	depends on TINKER_CORE
	default y
	help
	  Stable hashed hardware identity, obfuscatable.

config TINKER_RAY_AUDIO
	bool "Ray-traced audio DSP"
	depends on TINKER_CORE
	default y
	help
	  Geometric sound-propagation DSP (ray-cast reverb/occlusion).

config TINKER_NEURAL_AUDIO
	bool "Neural audio enhancement DSP"
	depends on TINKER_CORE
	default y
	help
	  Audio enhancement chain (gain/noise/EQ) DSP frontend.

config TINKER_PREWARM
	bool "Predictive pre-warm"
	depends on TINKER_CORE
	default y
	help
	  Predictive next-process memory/process prewarm with hit/miss
	  learning feedback.

config TINKER_POWER_GRID
	bool "Smart power grid"
	depends on TINKER_CORE
	default y
	help
	  Load/value-aware energy scheduling profile manager.

config TINKER_ADAPTIVE_DISPLAY
	bool "Adaptive display"
	depends on TINKER_CORE && BACKLIGHT_CLASS_DEVICE
	default y
	help
	  Adaptive refresh/brightness profile interface.

config TINKER_UNIFIED_MEM
	bool "Unified heterogeneous memory pool"
	depends on TINKER_CORE
	default y
	help
	  Software-defined memory tier placement registry (opt-in).

config TINKER_HW_TUNING
	bool "Low-level hardware tuning"
	depends on TINKER_CORE
	default y
	help
	  Governor/overclock/fan-curve tuning farm, consent-gated.

config TINKER_NEURAL_SUPERRES
	bool "Neural super-resolution DSP"
	depends on TINKER_CORE
	default y
	help
	  Upscale profile frontend (scale/sharpness/model).

config TINKER_PREDICT_RENDER
	bool "Predictive rendering"
	depends on TINKER_CORE
	default y
	help
	  Ahead-of-time frame pre-render with hit/miss feedback.

config TINKER_REMOTE_HW
	bool "Remote hardware API"
	depends on TINKER_CORE
	default y
	help
	  Opt-in, armed-token-gated remote h/w control slots.

config TINKER_SDGPU
	bool "Software-defined GPU control plane"
	depends on TINKER_CORE
	default y
	help
	  SD-GPU policy (compute share / latency / power cap) hints.

config TINKER_FINANCE_AUDIT
	bool "Local finance/subscription audit hooks"
	depends on TINKER_CORE
	default y
	help
	  Unused-subscription ledger hooks for the user-space auditor.

config TINKER_PKG_TRACKER
	bool "Package state tracker"
	depends on TINKER_CORE
	default y
	help
	  Kernel-level package install/update/remove event tracking.
	  Provides /proc/tinker/pkg interface for the user-space
	  package manager.

config TINKER_UPDATE_MONITOR
	bool "Update state monitor"
	depends on TINKER_CORE
	default y
	help
	  Kernel-level update scheduling and state tracking.
	  Provides /proc/tinker/update interface for the update system.

config TINKER_CLOUD_SYNC
	bool "Cloud sync state tracker"
	depends on TINKER_CORE
	default y
	help
	  Kernel-level cloud provider sync state tracking.
	  Provides /proc/tinker/cloud interface.

config TINKER_MOBILE_COMPANION
	bool "Mobile companion state"
	depends on TINKER_CORE
	default y
	help
	  Kernel-level phone connection and companion state.
	  Provides /proc/tinker/mobile interface.

config TINKER_ENTERPRISE
	bool "Enterprise domain state"
	depends on TINKER_CORE
	default y
	help
	  Kernel-level enterprise domain/SSO/MFA/GPO state tracking.
	  Provides /proc/tinker/enterprise interface.

config TINKER_DRIVER_MONITOR
	bool "Driver state monitor"
	depends on TINKER_CORE
	default y
	help
	  Kernel-level driver load/unload and version tracking.
	  Provides /proc/tinker/drivers interface.

config TINKER_HW_CERT
	bool "Hardware certification state"
	depends on TINKER_CORE
	default y
	help
	  Kernel-level hardware test results and certification tracking.
	  Provides /proc/tinker/cert interface.

config TINKER_APP_STORE
	bool "App ecosystem state"
	depends on TINKER_CORE
	default y
	help
	  Kernel-level app store installed apps and sync tracking.
	  Provides /proc/tinker/apps interface.

config TINKER_INSTALLER_STATE
	bool "Installer state tracker"
	depends on TINKER_CORE
	default y
	help
	  Kernel-level OS installation progress and state tracking.
	  Provides /proc/tinker/installer interface.

config TINKER_DESKTOP_STATE
	bool "Desktop environment state"
	depends on TINKER_CORE
	default y
	help
	  Kernel-level desktop panel/dock/theme/compositor state.
	  Provides /proc/tinker/desktop interface.

endif # TINKER_FEATURES
```

## terminal/Kconfig
```kconfig
# SPDX-License-Identifier: GPL-2.0
config TERMINAL_TYPO_CORRECTOR
	tristate "Terminal Typo Correction support"
	help
	  This module provides automatic typo correction for terminal commands.
	  It uses a simple edit distance algorithm to suggest corrections
	  for commonly mistyped commands.

	  To compile this driver as a module, choose M here: the
	  module will be called typo_corrector.

	  If unsure, say N.

config TERMINAL_ERROR_EXPLAINER
	tristate "Terminal Error Explanation support"
	help
	  This module provides detailed explanations for common kernel errors
	  and system messages. It intercepts kernel messages and adds helpful
	  explanations and fix suggestions.

	  To compile this driver as a module, choose M here: the
	  module will be called error_explainer.

	  If unsure, say N.

config SMART_INPUT
	tristate "Smart Input System support"
	depends on PROC_FS
	help
	  This module provides global smart input features for all Linux
	  applications:
	  - Accent character picker (long-press to see variants)
	  - Smart autocorrect with ghost text + Tab accept
	  - Timestamp converter (Unix → human readable)
	  - Unit converter (km↔miles, kg↔lbs, etc.)
	  - Clipboard history

	  Features are accessible via /proc/smart_input/ and netlink.

	  To compile this driver as a module, choose M here: the
	  module will be called smart_input.

	  If unsure, say N.
```
